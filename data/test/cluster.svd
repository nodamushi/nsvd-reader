# cluster register map
Vendor: CC0
foobar
CPU: CM4 r1p0, little endian, MPU, no FPU, 3 interrupt priority bits
Registers are 32-bit, read-only, reset 0x1 unless marked. A register's access mark holds for its fields unless they carry their own. Offsets are from the block's base; lines under a group give offsets from that group; [hi:lo] are bit positions; {n}, {i} and the like mark numbered series; 'fields as' and 'values as' point back to an identical list; <NAME> marks a mode.

## Memory map
0x00001000 A size 0x1000
0x00002000 B size 0x1000

## A
Base 0x00001000
0x00 B group
  0x00 X
  0x04 Y
  0x08 Z
0x64 D group
  0x00 N (reset mask 0x64)
  0xC8 C group
    0x04 Z (reset mask 0x64)
    0x0C X (reset mask 0x64)
0x190 C group
  0x00 X
  0x08 Z

## B
Base 0x00002000
0x00 D group
  0x00 N rw (reset mask 0x12C)
  0xC8 C group
    0x04 Z rw (reset mask 0x12C)
    0x0C X rw (reset mask 0x12C)
